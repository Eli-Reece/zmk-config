## config/west.yml
```yaml
manifest:
  defaults:
    revision: v0.3
  remotes:
    - name: zmkfirmware
      url-base: https://github.com/zmkfirmware
    - name: Eli-Reece
      url-base: https://github.com/Eli-Reece
  projects:
    - name: zmk
      remote: zmkfirmware
      import: app/west.yml
    - name: zmk-keyboard-eli
      remote: Eli-Reece
      revision: main
  self:
    path: config
```
